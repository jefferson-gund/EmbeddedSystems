
ESCREVE: 	;ENVIA INSTRUÇÃO PARA O LCD.


	MOVWF	NIBLE
	ANDLW	B'11110000'
	MOVWF	 DISPLAY

	NOP					; PERDE TEMPO PARA ESTABILIZAÇÃO
	BSF		ENABLE 		; ENVIA UM PULSO DE ENABLE AO DISPLAY
	NOP
	MOVLW 	.10
	CALL 	DELAY_2 	; DELAY DE 1mS
	BCF 	ENABLE 
	
	SWAPF 	NIBLE, W ; INVERTE O NIBLE PARA ENVIO.
	ANDLW	B'11110000'
	MOVWF	DISPLAY ;
	
	NOP					; PERDE TEMPO PARA ESTABILIZAÇÃO
	BSF		ENABLE 		; ENVIA UM PULSO DE ENABLE AO DISPLAY
	GOTO 	$+1 		;.
	MOVLW 	.10
	CALL 	DELAY_2 	; DELAY DE 1mS
	BCF 	ENABLE 


RETURN ;

;**************************************8
ESCREVE_ni: 	;ENVIA INSTRUÇÃO PARA O LCD.

	ANDLW	B'11110000'
	MOVWF	 DISPLAY

	NOP					; PERDE TEMPO PARA ESTABILIZAÇÃO
	BSF		ENABLE 		; ENVIA UM PULSO DE ENABLE AO DISPLAY
	NOP
	MOVLW 	.10
	CALL 	DELAY_2 	; DELAY DE 1mS
	BCF 	ENABLE 
	
RETURN ;
