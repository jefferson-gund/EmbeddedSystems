;********************************************************************
NIVEL_SABAO
	BCF		RS		; SELECIONA O DISPLAY P/ COMANDOS
	MOVLW 	0X80 		; COMANDO PARA POSICIONAR O CURSOR
	CALL 	ESCREVE 	; LINHA 1 / COLUNA 0
	BSF 	RS 			; SELECIONA O DISPLAY P/ DADOS
						; COMANDOS PARA ESCREVER AS
						; LETRAS DE "TENSÃO:"
	MOVLW	'N'
	CALL 	ESCREVE
	MOVLW	'I'
	CALL 	ESCREVE
	MOVLW	'V'
	CALL 	ESCREVE
	MOVLW	'E'
	CALL 	ESCREVE
	MOVLW	'L'
	CALL 	ESCREVE
	MOVLW	' '
	CALL 	ESCREVE
	MOVLW	'D'
	CALL 	ESCREVE
	MOVLW	'E'
	CALL 	ESCREVE
	MOVLW	' '
	CALL 	ESCREVE
	MOVLW	'S'
	CALL 	ESCREVE
	MOVLW	'A'
	CALL 	ESCREVE
	MOVLW	'B'
	CALL 	ESCREVE
	MOVLW	'A'
	CALL 	ESCREVE
	MOVLW	'O'
	CALL 	ESCREVE
	MOVLW	':'
	CALL 	ESCREVE
	BCF 	RS 				; SELECIONA O DISPLAY P/ COMANDO
	MOVLW 	0XC0			; COMANDO PARA POSICIONAR O CURSOR
	CALL 	ESCREVE 		; LINHA 2 / COLUNA 0

	BSF 	RS 

RETURN

NIVEL_AGUA
	BCF		RS		; SELECIONA O DISPLAY P/ COMANDOS
	MOVLW 	0X80 		; COMANDO PARA POSICIONAR O CURSOR
	CALL 	ESCREVE 	; LINHA 1 / COLUNA 0
	BSF 	RS 			; SELECIONA O DISPLAY P/ DADOS
						; COMANDOS PARA ESCREVER AS
						; LETRAS DE "TENSÃO:"
	MOVLW	'N'
	CALL 	ESCREVE
	MOVLW	'I'
	CALL 	ESCREVE
	MOVLW	'V'
	CALL 	ESCREVE
	MOVLW	'E'
	CALL 	ESCREVE
	MOVLW	'L'
	CALL 	ESCREVE
	MOVLW	' '
	CALL 	ESCREVE
	MOVLW	'D'
	CALL 	ESCREVE
	MOVLW	'E'
	CALL 	ESCREVE
	MOVLW	' '
	CALL 	ESCREVE
	MOVLW	'A'
	CALL 	ESCREVE
	MOVLW	'G'
	CALL 	ESCREVE
	MOVLW	'U'
	CALL 	ESCREVE
	MOVLW	'A'
	CALL 	ESCREVE
	MOVLW	':'
	CALL 	ESCREVE
	MOVLW	' '
	CALL 	ESCREVE
	MOVLW	' '
	CALL 	ESCREVE
	BCF 	RS 				; SELECIONA O DISPLAY P/ COMANDO
	MOVLW 	0XC0			; COMANDO PARA POSICIONAR O CURSOR
	CALL 	ESCREVE 		; LINHA 2 / COLUNA 0

	BSF 	RS 

RETURN

NIVEL_AMACIANTE
	BCF		RS		; SELECIONA O DISPLAY P/ COMANDOS
	MOVLW 	0X80 		; COMANDO PARA POSICIONAR O CURSOR
	CALL 	ESCREVE 	; LINHA 1 / COLUNA 0
	BSF 	RS 			; SELECIONA O DISPLAY P/ DADOS
						; COMANDOS PARA ESCREVER AS
						; LETRAS DE "TENSÃO:"
	MOVLW	'N'
	CALL 	ESCREVE
	MOVLW	'I'
	CALL 	ESCREVE
	MOVLW	'V'
	CALL 	ESCREVE
	MOVLW	'E'
	CALL 	ESCREVE
	MOVLW	'L'
	CALL 	ESCREVE
	MOVLW	' '
	CALL 	ESCREVE
	MOVLW	'A'
	CALL 	ESCREVE
	MOVLW	'M'
	CALL 	ESCREVE
	MOVLW	'A'
	CALL 	ESCREVE
	MOVLW	'C'
	CALL 	ESCREVE
	MOVLW	'I'
	CALL 	ESCREVE
	MOVLW	'A'
	CALL 	ESCREVE
	MOVLW	'N'
	CALL 	ESCREVE
	MOVLW	'T'
	CALL 	ESCREVE
	MOVLW	'E'
	CALL 	ESCREVE
	MOVLW	':'
	CALL 	ESCREVE
	BCF 	RS 				; SELECIONA O DISPLAY P/ COMANDO
	MOVLW 	0XC0			; COMANDO PARA POSICIONAR O CURSOR
	CALL 	ESCREVE 		; LINHA 2 / COLUNA 0

	BSF 	RS 

RETURN

TIPO_ROUPA
	BCF		RS		; SELECIONA O DISPLAY P/ COMANDOS
	MOVLW 	0X80 		; COMANDO PARA POSICIONAR O CURSOR
	CALL 	ESCREVE 	; LINHA 0 / COLUNA 3
	BSF 	RS 			; SELECIONA O DISPLAY P/ DADOS
						; COMANDOS PARA ESCREVER AS
						; LETRAS DE "TENSÃO:"
	MOVLW	'T'
	CALL 	ESCREVE
	MOVLW	'I'
	CALL 	ESCREVE
	MOVLW	'P'
	CALL 	ESCREVE
	MOVLW	'O'
	CALL 	ESCREVE
	MOVLW	' '
	CALL 	ESCREVE
	MOVLW	'D'
	CALL 	ESCREVE
	MOVLW	'E'
	CALL 	ESCREVE
	MOVLW	' '
	CALL 	ESCREVE
	MOVLW	'R'
	CALL 	ESCREVE
	MOVLW	'O'
	CALL 	ESCREVE
	MOVLW	'U'
	CALL 	ESCREVE
	MOVLW	'P'
	CALL 	ESCREVE
	MOVLW	'A'
	CALL 	ESCREVE
	MOVLW	':'
	CALL 	ESCREVE
	MOVLW	' '
	CALL 	ESCREVE
	MOVLW	' '
	CALL 	ESCREVE
	BCF 	RS 				; SELECIONA O DISPLAY P/ COMANDO
	MOVLW 	0XC0			; COMANDO PARA POSICIONAR O CURSOR
	CALL 	ESCREVE 		; LINHA 2 / COLUNA 0
	BSF 	RS 

RETURN

TIPO_SUJEIRA
	BCF		RS		; SELECIONA O DISPLAY P/ COMANDOS
	MOVLW 	0X80 		; COMANDO PARA POSICIONAR O CURSOR
	CALL 	ESCREVE 	; LINHA 0 / COLUNA 3
	BSF 	RS 			; SELECIONA O DISPLAY P/ DADOS
						; COMANDOS PARA ESCREVER AS
						; LETRAS DE "TENSÃO:"
	MOVLW	'T'
	CALL 	ESCREVE
	MOVLW	'I'
	CALL 	ESCREVE
	MOVLW	'P'
	CALL 	ESCREVE
	MOVLW	'O'
	CALL 	ESCREVE
	MOVLW	' '
	CALL 	ESCREVE
	MOVLW	'D'
	CALL 	ESCREVE
	MOVLW	'E'
	CALL 	ESCREVE
	MOVLW	' '
	CALL 	ESCREVE
	MOVLW	'S'
	CALL 	ESCREVE
	MOVLW	'U'
	CALL 	ESCREVE
	MOVLW	'J'
	CALL 	ESCREVE
	MOVLW	'E'
	CALL 	ESCREVE
	MOVLW	'I'
	CALL 	ESCREVE
	MOVLW	'R'
	CALL 	ESCREVE
	MOVLW	'A'
	CALL 	ESCREVE
	MOVLW	':'
	CALL 	ESCREVE
	BCF 	RS 				; SELECIONA O DISPLAY P/ COMANDO
	MOVLW 	0XC0			; COMANDO PARA POSICIONAR O CURSOR
	CALL 	ESCREVE 		; LINHA 2 / COLUNA 0
	BSF 	RS 

RETURN


MOSTRA_OPCAO
	BCF 	RS 				; SELECIONA O DISPLAY P/ COMANDO
	MOVLW 	0XC0			; COMANDO PARA POSICIONAR O CURSOR
	CALL 	ESCREVE 		; LINHA 2 / COLUNA 0

	BSF 	RS 	

	MOVF	OPCAO_INSERIDA,W	
	ADDLW	.48
	CALL 	ESCREVE	
	MOVLW	' '
	CALL 	ESCREVE
	MOVLW	'-'
	CALL 	ESCREVE
	MOVLW	' '
	CALL 	ESCREVE
	MOVLW	' '
	CALL 	ESCREVE
	MOVLW	' '
	CALL 	ESCREVE
	MOVLW	'<'
	CALL 	ESCREVE
	MOVLW	'P'
	CALL 	ESCREVE
	MOVLW	'R'
	CALL 	ESCREVE
	MOVLW	'E'
	CALL 	ESCREVE
	MOVLW	'S'
	CALL 	ESCREVE
	MOVLW	'S'
	CALL 	ESCREVE
	MOVLW	' '
	CALL 	ESCREVE
	MOVLW	'O'
	CALL 	ESCREVE
	MOVLW	'K'
	CALL 	ESCREVE
	MOVLW	'>'
	CALL 	ESCREVE
	BSF 	RS 
RETURN


MOSTRA_ETAPA4
	MOVF	OPCAO_INSERIDA,W
	XORLW	.1				;DÍGITO 1.
	BTFSC	STATUS,Z		;TESTA SE O DÍGITO INSERIDO É O NÚMERO 1.
	GOTO	COLORIDA

	BCF 	RS 				; SELECIONA O DISPLAY P/ COMANDO
	MOVLW 	0XC0			; COMANDO PARA POSICIONAR O CURSOR
	CALL 	ESCREVE 		; LINHA 2 / COLUNA 0

	BSF 	RS 
	


	
	MOVLW	'1'
	CALL 	ESCREVE
	MOVLW	'-'
	CALL 	ESCREVE
	MOVLW	' '
	CALL 	ESCREVE
	MOVLW	'R'
	CALL 	ESCREVE
	MOVLW	'O'
	CALL 	ESCREVE
	MOVLW	'U'
	CALL 	ESCREVE
	MOVLW	'P'
	CALL 	ESCREVE
	MOVLW	'A'
	CALL 	ESCREVE
	MOVLW	' '
	CALL 	ESCREVE
	MOVLW	'B'
	CALL 	ESCREVE
	MOVLW	'R'
	CALL 	ESCREVE
	MOVLW	'A'
	CALL 	ESCREVE
	MOVLW	'N'
	CALL 	ESCREVE
	MOVLW	'C'
	CALL 	ESCREVE
	MOVLW	'A'
	CALL 	ESCREVE
	MOVLW	' '
	CALL 	ESCREVE
	BSF 	RS 

	COLORIDA
	MOVF	OPCAO_INSERIDA,W
	XORLW	.2				;DÍGITO 1.
	BTFSC	STATUS,Z		;TESTA SE O DÍGITO INSERIDO É O NÚMERO 3.
	GOTO	COBERTOR

	
	MOVLW	'2'
	CALL 	ESCREVE
	MOVLW	'-'
	CALL 	ESCREVE
	MOVLW	'R'
	CALL 	ESCREVE
	MOVLW	'O'
	CALL 	ESCREVE
	MOVLW	'U'
	CALL 	ESCREVE
	MOVLW	'P'
	CALL 	ESCREVE
	MOVLW	'A'
	CALL 	ESCREVE
	MOVLW	' '
	CALL 	ESCREVE
	MOVLW	'C'
	CALL 	ESCREVE
	MOVLW	'O'
	CALL 	ESCREVE
	MOVLW	'L'
	CALL 	ESCREVE
	MOVLW	'O'
	CALL 	ESCREVE
	MOVLW	'R'
	CALL 	ESCREVE
	MOVLW	'I'
	CALL 	ESCREVE
	MOVLW	'D'
	CALL 	ESCREVE
	MOVLW	'A'
	CALL 	ESCREVE
	BSF 	RS 

	COBERTOR
	MOVF	OPCAO_INSERIDA,W
	XORLW	.3				;DÍGITO 1.
	BTFSC	STATUS,Z		;TESTA SE O DÍGITO INSERIDO É O NÚMERO 3.
	GOTO	DELICADA

	
	MOVLW	'3'
	CALL 	ESCREVE
	MOVLW	'-'
	CALL 	ESCREVE
	MOVLW	' '
	CALL 	ESCREVE
	MOVLW	'C'
	CALL 	ESCREVE
	MOVLW	'O'
	CALL 	ESCREVE
	MOVLW	'B'
	CALL 	ESCREVE
	MOVLW	'E'
	CALL 	ESCREVE
	MOVLW	'R'
	CALL 	ESCREVE
	MOVLW	'T'
	CALL 	ESCREVE
	MOVLW	'O'
	CALL 	ESCREVE
	MOVLW	'R'
	CALL 	ESCREVE
	MOVLW	' '
	CALL 	ESCREVE
	MOVLW	' '
	CALL 	ESCREVE
	MOVLW	' '
	CALL 	ESCREVE
	MOVLW	' '
	CALL 	ESCREVE
	MOVLW	' '
	CALL 	ESCREVE
	BSF 	RS 


	DELICADA
	MOVF	OPCAO_INSERIDA,W
	XORLW	.4				;DÍGITO 1.
	BTFSC	STATUS,Z		;TESTA SE O DÍGITO INSERIDO É O NÚMERO 4.
	RETURN

	
	MOVLW	'4'
	CALL 	ESCREVE
	MOVLW	'-'
	CALL 	ESCREVE
	MOVLW	'R'
	CALL 	ESCREVE
	MOVLW	'O'
	CALL 	ESCREVE
	MOVLW	'U'
	CALL 	ESCREVE
	MOVLW	'P'
	CALL 	ESCREVE
	MOVLW	'A'
	CALL 	ESCREVE
	MOVLW	' '
	CALL 	ESCREVE
	MOVLW	'D'
	CALL 	ESCREVE
	MOVLW	'E'
	CALL 	ESCREVE
	MOVLW	'L'
	CALL 	ESCREVE
	MOVLW	'I'
	CALL 	ESCREVE
	MOVLW	'C'
	CALL 	ESCREVE
	MOVLW	'A'
	CALL 	ESCREVE
	MOVLW	'D'
	CALL 	ESCREVE
	MOVLW	'A'
	CALL 	ESCREVE
	BSF 	RS 
RETURN

MOSTRA_ETAPA5
	MOVF	OPCAO_INSERIDA,W
	XORLW	.0				;DÍGITO 1.
	BTFSC	STATUS,Z		;TESTA SE O DÍGITO INSERIDO É O NÚMERO 1.
	GOTO	SUJA


	BCF 	RS 				; SELECIONA O DISPLAY P/ COMANDO
	MOVLW 	0XC0			; COMANDO PARA POSICIONAR O CURSOR
	CALL 	ESCREVE 		; LINHA 2 / COLUNA 0

	BSF 	RS 
	

	
	MOVLW	'1'
	CALL 	ESCREVE
	MOVLW	'-'
	CALL 	ESCREVE
	MOVLW	' '
	CALL 	ESCREVE
	MOVLW	'P'
	CALL 	ESCREVE
	MOVLW	'O'
	CALL 	ESCREVE
	MOVLW	'U'
	CALL 	ESCREVE
	MOVLW	'C'
	CALL 	ESCREVE
	MOVLW	'O'
	CALL 	ESCREVE
	MOVLW	' '
	CALL 	ESCREVE
	MOVLW	'S'
	CALL 	ESCREVE
	MOVLW	'U'
	CALL 	ESCREVE
	MOVLW	'J'
	CALL 	ESCREVE
	MOVLW	'A'
	CALL 	ESCREVE
	MOVLW	' '
	CALL 	ESCREVE
	MOVLW	' '
	CALL 	ESCREVE
	MOVLW	' '
	CALL 	ESCREVE

	SUJA

	MOVF	OPCAO_INSERIDA,W
	XORLW	.1				;DÍGITO 1.
	BTFSC	STATUS,Z		;TESTA SE O DÍGITO INSERIDO É O NÚMERO 1.
	GOTO	MUITO_SUJA

	
	MOVLW	'2'
	CALL 	ESCREVE
	MOVLW	'-'
	CALL 	ESCREVE
	MOVLW	'S'
	CALL 	ESCREVE
	MOVLW	'U'
	CALL 	ESCREVE
	MOVLW	'J'
	CALL 	ESCREVE
	MOVLW	'A'
	CALL 	ESCREVE
	MOVLW	' '
	CALL 	ESCREVE
	MOVLW	' '
	CALL 	ESCREVE
	MOVLW	' '
	CALL 	ESCREVE
	MOVLW	' '
	CALL 	ESCREVE
	MOVLW	' '
	CALL 	ESCREVE
	MOVLW	' '
	CALL 	ESCREVE
	MOVLW	' '
	CALL 	ESCREVE
	MOVLW	' '
	CALL 	ESCREVE
	MOVLW	'D'
	CALL 	ESCREVE
	MOVLW	'A'
	CALL 	ESCREVE

	MUITO_SUJA

	MOVF	OPCAO_INSERIDA,W
	XORLW	.2				;DÍGITO 1.
	BTFSC	STATUS,Z		;TESTA SE O DÍGITO INSERIDO É O NÚMERO 2.
	GOTO	$+33

	
	MOVLW	'3'
	CALL 	ESCREVE
	MOVLW	'-'
	CALL 	ESCREVE
	MOVLW	'M'
	CALL 	ESCREVE
	MOVLW	'U'
	CALL 	ESCREVE
	MOVLW	'I'
	CALL 	ESCREVE
	MOVLW	'T'
	CALL 	ESCREVE
	MOVLW	'O'
	CALL 	ESCREVE
	MOVLW	' '
	CALL 	ESCREVE
	MOVLW	'S'
	CALL 	ESCREVE
	MOVLW	'U'
	CALL 	ESCREVE
	MOVLW	'J'
	CALL 	ESCREVE
	MOVLW	'A'
	CALL 	ESCREVE
	MOVLW	' '
	CALL 	ESCREVE
	MOVLW	' '
	CALL 	ESCREVE
	MOVLW	' '
	CALL 	ESCREVE
	MOVLW	' '
	CALL 	ESCREVE

RETURN
