;* * * * * * * * * * * * * * * * * * * * * * * * * * * * * * * * * *
;*	            	 ROTINAS E SUBROTINAS                      	   *
;* * * * * * * * * * * * * * * * * * * * * * * * * * * * * * * * * *
; CADA ROTINA OU SUBROTINA DEVE POSSUIR A DESCRIÇÃO DE FUNCIONAMENTO
; E UM NOME COERENTE ÀS SUAS FUNÇÕES.

LEITURA
	MOVLW	B'11111110'
	MOVWF	LINHA			
	
START:
	MOVWF	PORTC			;começa no bit 0
	MOVF	PORTB,W	
	MOVWF	COLUNA			;GUARDA PORTB EM COLUNA
	
	MOVLW	B'11110000'		;MÁSCARA NO REGISTRADOR COLUNA
	IORWF	COLUNA,W		;PARA LIMPAR OS BITS MAIS SIGNIFICATIVOS
	XORLW	0xFF			;operação lógica, verifica se tecla não
	BTFSC	STATUS,Z		;foi acionada
	GOTO	ROTACIONAR		;não foi acionada
	GOTO	TEST_TECLA
	
ROTACIONAR:
	BSF		STATUS,C
	MOVLW	B'11110111'
	XORWF	LINHA,W			;chegou ao bit 0?
	BTFSC	STATUS,Z		;
	GOTO 	LEITURA			;sim
	RLF		LINHA			;não
	MOVF	LINHA,W
	GOTO 	START

TEST_TECLA:
	MOVLW	.5				;TEMPO DE 5ms
	CALL	DELAY
	MOVF	PORTB,W	
	MOVWF	COLUNA			;GUARDA PORTB EM COLUNA
ESPERA:
	MOVF	PORTB,W	
	IORWF	COLUNA,W		;PARA LIMPAR OS BITS MAIS SIGNIFICATIVOS
	XORLW	0xFF
	BTFSS	STATUS,Z
	GOTO	ESPERA
	GOTO	DET_TECLA
	
;* * * * * * * * * * * * * * * * * * * * * * * * * * * * * * 
;*				SUBROTINAS								   *
;* * * * * * * * * * * * * *  * * * * * * *  * * * * * * * *
DET_TECLA:
	BTFSS	LINHA,3		;VERIFICA QUAL LINHA ESTÁ ACIONADA
	GOTO	LINHA3
	BTFSS	LINHA,2
	GOTO	LINHA2
	BTFSS	LINHA,1
	GOTO	LINHA1

LINHA0:
	BTFSC	COLUNA,1	;TESTA SE É O DÍGITO 1
	GOTO 	$+6
	MOVLW	.1
	MOVWF	OPCAO_INSERIDA
	CALL	MOSTRA_OPCAO	;ESPERA CONFIRMAÇÃO OU RETORNO (DÍGITO F)
	CALL	CONFIRMA_CANCELA
	GOTO	LEITURA

	BTFSC	COLUNA,2	;TESTA SE É O DÍGITO 2
	GOTO 	$+6
	MOVLW	.2
	MOVWF	OPCAO_INSERIDA
	CALL	MOSTRA_OPCAO	;ESPERA CONFIRMAÇÃO OU RETORNO (DÍGITO F)
	CALL	CONFIRMA_CANCELA
	
	BTFSC	COLUNA,3	;TESTA SE É O DÍGITO 3
	GOTO 	$+5
	MOVLW	.3
	MOVWF	OPCAO_INSERIDA
	CALL	MOSTRA_OPCAO	;ESPERA CONFIRMAÇÃO OU RETORNO (DÍGITO F)
	CALL	CONFIRMA_CANCELA
	GOTO	LEITURA


LINHA1:
	BTFSC	COLUNA,0	;TESTA SE É O DÍGITO 4
	GOTO 	$+5
	MOVLW	.3
	MOVWF	OPCAO_INSERIDA
	CALL	MOSTRA_OPCAO	;ESPERA CONFIRMAÇÃO OU RETORNO (DÍGITO F)
	CALL	CONFIRMA_CANCELA

	GOTO	LEITURA


LINHA2:

	MOVLW	.5
	XORWF	ETAPA_CONFIG	;TESTA SE A CONFIGURAÇÃO ESTÁ NA ETAPA5
	BTFSC	STATUS,2
	GOTO	LEITURA
	
	MOVF	PORTB,W
	MOVWF	COLUNA
	BTFSC	COLUNA,2		;TECLA DECREMENTA (-) ?
	GOTO	INCREMENTA

	MOVLW	.1
	CALL	DELAY
	MOVF	PORTB,W
	MOVWF	COLUNA
	BTFSS	COLUNA,2	
	GOTO	$-3

	MOVLW	.0	
	XORWF	OPCAO_INSERIDA,W
	BTFSS	STATUS,2
	GOTO	$+4
	DECF	OPCAO_INSERIDA,F
	CALL	MOSTRA_ETAPA5
	RETURN

	MOVLW	.2
	MOVWF	OPCAO_INSERIDA
	CALL	MOSTRA_ETAPA5
	CALL	CONFIRMA_CANCELA

	GOTO	LEITURA

INCREMENTA
	MOVF	PORTB,W
	MOVWF	COLUNA
	BTFSC	COLUNA,3		;TECLA INCREMENTA (+) ?
	GOTO	LEITURA

	MOVLW	.1
	CALL	DELAY
	MOVF	PORTB,W
	MOVWF	COLUNA
	BTFSS	COLUNA,3	
	GOTO	$-3

	MOVLW	.2	
	XORWF	OPCAO_INSERIDA,W
	BTFSS	STATUS,2
	GOTO	$+4
	DECF	OPCAO_INSERIDA,F
	CALL	MOSTRA_ETAPA5
	RETURN

	MOVLW	.0
	MOVWF	OPCAO_INSERIDA
	CALL	MOSTRA_ETAPA5
	CALL	CONFIRMA_CANCELA
	
	GOTO	LEITURA



LINHA3:
	BTFSC	COLUNA,0	;TESTA SE É O DÍGITO "RESET"
	GOTO 	$+8
	
	MOVLW	.1
	CALL	DELAY
	BTFSC	COLUNA,0	;TESTA SE É O DÍGITO "RESET"
	GOTO 	$+4
	BTFSS	COLUNA,0
	GOTO	$-1
	GOTO	MAIN	;VOLTA PARA O INÍCIO DO MAIN CASO PRESSIONE A TECLA "RESET"


	MOVLW	.6
	XORWF	ETAPA_CONFIG	;TESTA SE JA ESTÁ NA ETAPA 6 DE CONFIGURAÇÃO.
	BTFSC	STATUS,2
	GOTO	LEITURA


	BTFSC	COLUNA,1	;TESTA SE É O DÍGITO "PAUSAR"
	GOTO 	$+9
	
	MOVLW	.1
	CALL	DELAY
	BTFSC	COLUNA,1	;TESTA SE É O DÍGITO "PAUSAR"
	GOTO 	$+5
	BTFSS	COLUNA,1
	GOTO	$-1
	MOVLW	.12
	MOVWF	OPCAO_INSERIDA


	PAUSAR_

	BTFSC	COLUNA,2	;TESTA SE É O DÍGITO "CONTINUAR"
	GOTO 	$+9
	
	MOVLW	.1
	CALL	DELAY
	BTFSC	COLUNA,2	;TESTA SE É O DÍGITO "CONTINUAR"
	GOTO 	$+5
	BTFSS	COLUNA,2
	GOTO	$-1
	MOVLW	.13
	MOVWF	OPCAO_INSERIDA

	GOTO	LEITURA


CONFIRMA_CANCELA		;NESTA ROTINA O PROGRAMA FICA AGUARDANDO A CONFIRMAÇÃO OU CANCELAMENTO DA OPCAO INSERIDA.
	CALL	MOSTRA_OPCAO
	MOVLW	B'11110111'
	MOVWF	PORTC
	BTFSC	COLUNA,3	;TESTA SE O DIGITO INSERIDO É "ENTER".
	GOTO	ETAPAS
	MOVLW	.1
	CALL	DELAY
	BTFSC	COLUNA,3
	GOTO	ETAPAS
	BTFSS	COLUNA,3	;ESPERA ATÉ SOLTAR A TECLA.
	GOTO	$-1
	CALL	SALVA_OPCAO
	RETURN

	ETAPAS

	MOVLW	.5
	XORWF	ETAPA_CONFIG,W		;É A ETAPA 5?
	BTFSC	STATUS,2
	GOTO	TESTA_ETAPA5		;SIM

	MOVLW	B'11111101'
	MOVWF	PORTC		;TESTA SE ALGUMA TECLA DA LINHA 1 FOI PRESSIONADA
	MOVF	PORTB,W
	MOVWF	COLUNA
	MOVLW	B'11111111'
	XORWF	COLUNA,W

	BTFSS	STATUS,2
	GOTO	TESTE_LINHA0	;SE ALGUMA TECLA DESTA LINHA FOI PRESSIONADA, RETORNA PARA A ROTINA DE LEITURA PARA
								;IDENTIFICAR TECLA PRESSIONADA.

	MOVLW	.1
	CALL	DELAY
	MOVF	PORTB,W
	MOVWF	COLUNA
	MOVLW	B'11111111'
	XORWF	COLUNA,W
	BTFSC	STATUS,2
	GOTO	$-5
	RETURN

	TESTE_LINHA0
	MOVLW	B'11111110'
	MOVWF	PORTC		;TESTA SE ALGUMA TECLA DA LINHA 0 FOI PRESSIONADA
	MOVF	PORTB,W
	MOVWF	COLUNA
	MOVLW	B'11111111'
	XORWF	COLUNA,W

	BTFSS	STATUS,2
	GOTO	CONFIRMA_CANCELA	;SE ALGUMA TECLA DESTA LINHA FOI PRESSIONADA, RETORNA PARA A ROTINA DE LEITURA PARA
								;IDENTIFICAR TECLA PRESSIONADA.

	MOVLW	.1
	CALL	DELAY
	MOVF	PORTB,W
	MOVWF	COLUNA
	MOVLW	B'11111111'
	XORWF	COLUNA,W
	BTFSC	STATUS,2
	GOTO	$-5
	RETURN


	TESTA_ETAPA5
	MOVLW	B'11111011'
	MOVWF	PORTC		;TESTA SE ALGUMA TECLA DA LINHA 2 FOI PRESSIONADA
	MOVF	PORTB,W
	MOVWF	COLUNA
	MOVLW	B'11111111'
	XORWF	COLUNA,W

	BTFSS	STATUS,2
	GOTO	CONFIRMA_CANCELA	;SE ALGUMA TECLA DESTA LINHA FOI PRESSIONADA, RETORNA PARA A ROTINA DE LEITURA PARA
								;IDENTIFICAR TECLA PRESSIONADA.

	MOVLW	.1
	CALL	DELAY
	MOVF	PORTB,W
	MOVWF	COLUNA
	MOVLW	B'11111111'
	XORWF	COLUNA,W
	BTFSC	STATUS,2
	GOTO	$-5
	RETURN



SALVA_OPCAO
	
	MOVF	OPCAO_INSERIDA,W
	BANKSEL EEDATA
	MOVWF	EEDATA
	BANKSEL	ENDERECO
	MOVF	ENDERECO,W
	BANKSEL EEADR
	MOVWF	EEADR
	BANKSEL EECON1
	BCF		EECON1,EEPGD
	BSF		EECON1,WREN
	MOVLW	0x55
	MOVWF	EECON2 			;OBRIGATÓRIO
	MOVLW	0xAA
	MOVWF	EECON2 			;OBRIGATÓRIO
	BSF		EECON1,WR 		;INICIA ESCRITA
	BTFSC	EECON1,WR
	GOTO	$-1
	BCF		EECON1,WREN
	BANKSEL OPCAO_INSERIDA
	INCF	ENDERECO

	MOVLW	.1
	XORLW	ETAPA_CONFIG
	BTFSC	STATUS,2
	GOTO	ETAPA2





	RETURN
	
LEITURA_EEPROM:
	
	MOVF	ENDERECO,W
	BANKSEL EEADR
	MOVWF	EEADR
	BANKSEL EECON1
	BCF		EECON1,EEPGD
	BSF		EECON1,RD
	BANKSEL EEDATA
	MOVF	EEDATA,W
	BANKSEL OPCAO_INSERIDA
	MOVWF	OPCAO_INSERIDA

RETURN