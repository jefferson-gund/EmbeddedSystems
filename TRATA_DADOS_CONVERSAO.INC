DELAY_2
	MOVWF	DELAY2
	
DELAY_MS
	MOVLW	T6
	MOVWF	DELAY1
	
DELAY_US
	MOVLW	T240
	MOVWF	DELAY0
	DECFSZ	DELAY0,F
	GOTO	$-1
	
	DECFSZ	DELAY1,F
	GOTO	DELAY_US

	DECFSZ	DELAY2
	GOTO	DELAY_MS

RETURN


DELAY

	movlw	TEMPO_DELAY
	movwf	TEMPO1

	movlw	TEMPO_DELAY
	movwf	TEMPO2
	decfsz	TEMPO2,F	
	goto	$-1			;RETORNA À LINHA ANTERIOR E DECREMENTA O CONTADOR TEMPO1
	decfsz	TEMPO1,F
	goto	$-5			;RETORNA À LINHA ANTERIOR E DECREMENTA O CONTADOR TEMPO2

	return

;**************************************************************************
;* * * * * * * * * * * * * * * * * * * * * * * * * * * * * * * * * *
;*	           			 	CONVERSÃO A/D 	                       *
;* * * * * * * * * * * * * * * * * * * * * * * * * * * * * * * * * *
;ESTA SUB-ROTINA EFETUA A CONVERSAO A/D E ARMAZENA O BYTE	OBTIDO NA CONVERSÃO NO REGS DADO


CONVERSAO_AD

	MOVLW	.1
	CALL	DELAY_2				;DELAY DE 1mS
	BSF		ADCON0,GO			;HABILITA A CONVERSAO
	BTFSC	ADCON0,GO			;SE ADCON,GO = 0, A CONVERSAO JÁ TERMINOU
	GOTO	$-1

	MOVF	ADRESH,W		
	MOVWF	MULT1_H			;MULTIHIGH = ADRESH

	BANK1
	MOVF	ADRESL,W

	BANK0
	MOVWF	MULT1_L

	MOVLW	b'00110001'		
	MOVWF	MULT_2			
	CALL	MULTI_10x8		;MULTIPLICA ADRESH E ADRESL PELO PASSO VEZES 1000, POIS O TRATAMENTO NUMERICO NÃo SERA DIRETAMENTE
							;EXECUTADO POR PONTO FLUTUANTE (49...X *(5/1024) = X * 0.0049) 

	MOVF	PRODUTO_H,W	
	MOVWF	DIVIDENDO_H 	;DIVIDENDO_H = PARTE ALTA DO PRODUTO.
	MOVF	PRODUTO_L,W	
	MOVWF	DIVIDENDO_L		;DIVIDENDO_L = PARTE BAIXA DO PRODUTO.

	MOVLW	b'00010000'		
	MOVWF	DIVISOR_L		;MOVE CONTEUDO DE W PARA A PARTE BAIXA DO DIVISOR
	MOVLW	b'00100111'		;MOVE A PARTE ALTA DE 10000 PARA W
	MOVWF	DIVISOR_H	

	CALL	DIVIDE_16x16

	MOVF	QUOCIENTE_L,W
	MOVWF	UNIDADE

	MOVF	RESTO_H,W	
	MOVWF	DIVIDENDO_H  
	MOVF	RESTO_L,W		
	MOVWF	DIVIDENDO_L	
	
	MOVLW	b'00000011'		;MOVE A PARTE ALTA DE 1000 PARA W
	MOVWF	DIVISOR_H	;MOVE O CONTEUDO DE W PARA A PARTE ALTA DO DIVISOR
	MOVLW	b'11101000'		;MOVE A PARTE BAIXA DE 1000 PARA W
	MOVWF	DIVISOR_L	;MOVE CONTEUDO DE W PARA A PARTE BAIXA DO DIVISOR


	CALL	DIVIDE_16x16

	MOVF	QUOCIENTE_L,W
	MOVWF	DEZENA

	MOVF	RESTO_H,W	;MOVE A PARTE ALTA DO PRODUTO PARA W
	MOVWF	DIVIDENDO_H ;MOVE O CONTEUDO DE W PARA A PARTE ALTA DO DIVIDENDO
	MOVF	RESTO_L,W		;MOVE A PARTE BAIXA DO PRODUTO PARA W
	MOVWF	DIVIDENDO_L	;MOVE O CONTEUDO DE W PARA A PARTE BAIXA DO DIVIDENDO

	MOVLW	b'00000000'			;MOVE A PARTE ALTA DE 100 PARA W
	MOVWF	DIVISOR_H	;MOVE O CONTEUDO DE W PARA A PARTE ALTA DO DIVISOR
	MOVLW	b'01100100'		;MOVE A PARTE BAIXA DE 100 PARA W
	MOVWF	DIVISOR_L	;MOVE CONTEUDO DE W PARA A PARTE BAIXA DO DIVISOR


	CALL	DIVIDE_16x16

	MOVF	QUOCIENTE_L,W
	MOVWF	CENTENA

	MOVF	RESTO_H,W	
	MOVWF	DIVIDENDO_H
	MOVF	RESTO_L,W		
	MOVWF	DIVIDENDO_L

	MOVLW	b'00000000'				
	MOVWF	DIVISOR_H	
	MOVLW	b'00001010'		
	MOVWF	DIVISOR_L	

	CALL	DIVIDE_16x16 
 
	MOVF	QUOCIENTE_L,W
	MOVWF	MILHAR

	MOVF	RESTO_L,W
	MOVWF	MILHAO

RETURN
















	

	
