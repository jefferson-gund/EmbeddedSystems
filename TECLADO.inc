;* * * * * * * * * * * * * * * * * * * * * * * * * * * * * * * * * *
;*	            	 ROTINAS E SUBROTINAS                      	   *
;* * * * * * * * * * * * * * * * * * * * * * * * * * * * * * * * * *
; CADA ROTINA OU SUBROTINA DEVE POSSUIR A DESCRIÇÃO DE FUNCIONAMENTO
; E UM NOME COERENTE ÀS SUAS FUNÇÕES.

	

TECLADO:
	MOVLW	B'11111110'
	MOVWF	LINHA			;
	
START:
	MOVWF	PORTC			;começa no bit 0
	MOVF	PORTB,W	
	MOVWF	COLUNA			;GUARDA PORTB EM LEITURA
	
	MOVLW	B'11110000'		;MÁSCARA NO REGISTRADOR LEITURA
	IORWF	COLUNA,W		;PARA LIMPAR OS BITS MAIS SIGNIFICATIVOS
	XORLW	0xFF			;operação lógica, verifica se tecla não
	BTFSC	STATUS,Z		;foi acionada
	GOTO	ROTACIONAR		;não foi acionada
	GOTO	TEST_TECLA
	
ROTACIONAR:
	BSF		STATUS,C
	MOVLW	B'11110111'
	XORWF	LINHA,W			;chegou ao bit 0?
	BTFSC	STATUS,Z		;
	GOTO 	TECLADO			;sim
	RLF		LINHA			;não
	MOVF	LINHA,W
	GOTO 	START

TEST_TECLA:
	MOVLW	.5				;TEMPO DE 5ms
	CALL	DELAY
	MOVF	PORTB,W	
	MOVWF	COLUNA			;GUARDA PORTB EM LEITURA
ESPERA:
	MOVF	PORTB,W	
	IORWF	COLUNA,W		;PARA LIMPAR OS BITS MAIS SIGNIFICATIVOS
	XORLW	0xFF
	BTFSS	STATUS,Z
	GOTO	ESPERA
	GOTO	DET_TECLA
	
;* * * * * * * * * * * * * * * * * * * * * * * * * * * * * * 
;*				SUBROTINAS								   *
;* * * * * * * * * * * * * *  * * * * * * *  * * * * * * * *
DET_TECLA:
	BTFSS	LINHA,3		;VERIFICA QUAL LINHA ESTÁ ACIONADA
	GOTO	LINHA3
	BTFSS	LINHA,2
	GOTO	LINHA2
	BTFSS	LINHA,1
	GOTO	LINHA1

LINHA0:
	INCF	CARACTER
	BTFSS	COLUNA,0	;TESTA SE ÚLTIMO BIT DE COLUNA
	GOTO	ATUALIZA
	RRF		COLUNA
	GOTO	LINHA0
	
D_CARACTER
	INCF	CARACTER
	BTFSS	COLUNA,0	;INCREMENTA CARACTER
	GOTO	$+3
	RRF		COLUNA
	GOTO	$-4

	RETURN

LINHA3:
	MOVLW	0x0C
	MOVWF	CARACTER	;POSICIONA CARACTER
	CALL	D_CARACTER
	GOTO 	ATUALIZA
	
LINHA2:
	MOVLW	0x08
	MOVWF	CARACTER
	CALL	D_CARACTER
	GOTO	ATUALIZA
	
LINHA1:
	MOVLW	0x04
	MOVWF	CARACTER
	CALL	D_CARACTER
	
ATUALIZA:
	CALL 	AT_PORT
	;MOVWF	PORTD			;move conteúdo para portD
	CLRF	CARACTER
	RETURN						;GOTO	MAIN

;*******************************************************
AT_PORT
	MOVF	CARACTER,W
	ADDWF	PCL,F
	NOP
	RETLW	.48	;B'00000011'	;RETORNA SIMBOLO 0
	RETLW	.49	;B'10011111'	;RETORNA SIMBOLO 1
	RETLW	.50	;B'00100101'	;RETORNA SIMBOLO 2
	RETLW	.51	;B'00001101'	;RETORNA SIMBOLO 3
	RETLW	.52	;B'10011001'	;RETORNA SIMBOLO 4
	RETLW	.53	;B'01001001'	;RETORNA SIMBOLO 5
	RETLW	.54	;B'01000001'	;RETORNA SIMBOLO 6
	RETLW	.55	;B'00011111'	;RETORNA SIMBOLO 7
	RETLW	.56	;B'00000001'	;RETORNA SIMBOLO 8
	RETLW	.57	;B'00011001'	;RETORNA SIMBOLO 9
	RETLW	B'00010001'	;RETORNA SIMBOLO A
	RETLW	B'11000001'	;RETORNA SIMBOLO B
	RETLW	B'01100011'	;RETORNA SIMBOLO C
	RETLW	B'10000101'	;RETORNA SIMBOLO D
	RETLW	B'01100001'	;RETORNA SIMBOLO E
	RETLW	B'01110001'	;RETORNA SIMBOLO F